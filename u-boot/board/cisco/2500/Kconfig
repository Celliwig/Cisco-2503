## u-boot/board/cisco/2500/Kconfig
```kconfig
if TARGET_CISCO_2500

config SYS_CPU
        string
        default "m680x0"

config SYS_BOARD
        string
        default "2500"

config SYS_VENDOR
        string
        default "cisco"

config SYS_CONFIG_NAME
        string
        default "cisco-2500"

endif
```

## u-boot/configs/cisco2500_defconfig
```kconfig
CONFIG_M68K=y
CONFIG_SYS_TEXT_BASE=0x01000000
CONFIG_SYS_MALLOC_F_LEN=0x400
CONFIG_TARGET_CISCO_2500=y
CONFIG_BOARD_EARLY_INIT_R=y
CONFIG_SCN2681_SERIAL=y
CONFIG_BAUDRATE=9600
CONFIG_DEFAULT_DEVICE_TREE="cisco-2500"
CONFIG_BOOTDELAY=3
#CONFIG_SYS_CONSOLE_INFO_QUIET=y
CONFIG_DISPLAY_BOARDINFO=y
CONFIG_CMDLINE_EDITING=y
CONFIG_SYS_LONGHELP=y
CONFIG_SYS_PROMPT="Celliwig $ "
CONFIG_LOOPW=y

# Environment
CONFIG_ENV_IS_IN_EEPROM=y
CONFIG_ENV_SIZE=0x8000
CONFIG_ENV_OFFSET=0x0000

# MTD
CONFIG_MTD=y
CONFIG_DM_MTD=y
CONFIG_MTD_PARTITIONS=y
CONFIG_MTD_NOR_FLASH=y
CONFIG_SYS_MTDPARTS_RUNTIME=y
CONFIG_FLASH_CFI_DRIVER=y
CONFIG_FLASH_CFI_MTD=y
CONFIG_CFI_FLASH=y
#CONFIG_SYS_FLASH_USE_BUFFER_WRITE=y
#CONFIG_SYS_FLASH_PROTECTION=y
CONFIG_SYS_FLASH_CFI=y

# Net
CONFIG_NET=y
CONFIG_NET_RANDOM_ETHADDR=y
CONFIG_DM_ETH=y
CONFIG_LANCE_79C92=y
CONFIG_LANCE_79C92_QUIRK_CISCO2500=y

# Reset Controller
CONFIG_DM_RESET=y
CONFIG_REGMAP=y
CONFIG_SYSCON=y
CONFIG_RESET_SYSCON=y

# CMDs
# CONFIG_CMD_BOOTD is not set
CONFIG_CMD_CACHE=y
CONFIG_CMD_DIAG=y
CONFIG_CMD_DM=y
CONFIG_CMD_EEPROM_PARALLEL=y
CONFIG_CMD_FLASH=y
#CONFIG_CMD_IMLS=y
CONFIG_CMD_MX_CYCLIC=y
CONFIG_CMD_NET=y
CONFIG_CMD_PING=y
# CONFIG_CMD_SETEXPR is not set
CONFIG_CMD_SLEEP=y
CONFIG_CMD_TFTPBOOT=y
CONFIG_CMD_TIMER=y
# CONFIG_CMD_XIMG is not set
```
